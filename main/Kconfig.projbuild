## main/Kconfig.projbuild
```kconfig
menu "Control Panel Configuration"

    config CTLPANEL_DEVICE_ID
        string "Device id override"
        default ""
        help
            Names the MQTT topics (panel/<id>/...) and the mDNS host. Empty
            (the default) derives a unique "panel-xxxxxx" from the MAC.

    config CTLPANEL_WIFI_SSID
        string "Wi-Fi SSID (dev fallback)"
        default ""
        help
            Normally Wi-Fi is provisioned over BLE from the Home Assistant
            app (Improv). Fill these in only to skip that during development.

    config CTLPANEL_WIFI_PASSWORD
        string "Wi-Fi password (dev fallback)"
        default ""

    config CTLPANEL_CLOCK_24H
        bool "Show times in 24-hour format"
        default n

    choice CTLPANEL_RENDERER
        prompt "Renderer"
        default CTLPANEL_RENDER_LCD

        config CTLPANEL_RENDER_LCD
            bool "ST7789 LCD (LVGL)"

        config CTLPANEL_RENDER_LOG
            bool "Serial log only (no display attached)"
    endchoice

    config CTLPANEL_LCD_LANDSCAPE
        bool "Landscape (320x240); off = portrait (240x320)"
        default y

    config CTLPANEL_LCD_ROTATE_180
        bool "Rotate 180 degrees (mounted upside down)"
        default n

    config CTLPANEL_LCD_INVERT
        bool "Invert LCD colors (typical for IPS ST7789 panels)"
        default y

    config CTLPANEL_BACKLIGHT_DIM_PERCENT
        int "Backlight level when dimmed (percent)"
        default 10
        range 0 100

    menu "Pins (SparkFun Pro Micro ESP32-C3)"

        config CTLPANEL_PIN_SCLK
            int "LCD SCLK (SCL/SCK)"
            default 6

        config CTLPANEL_PIN_MOSI
            int "LCD MOSI (SDA)"
            default 7

        config CTLPANEL_PIN_CS
            int "LCD CS (-1 if tied low)"
            range -1 21
            default 10

        config CTLPANEL_PIN_DC
            int "LCD DC"
            default 4

        config CTLPANEL_PIN_RST
            int "LCD RST (-1 if not wired)"
            range -1 21
            default 5

        config CTLPANEL_PIN_BACKLIGHT
            int "LCD backlight BLK (-1 if tied high)"
            range -1 21
            default 3

        config CTLPANEL_PIN_I2C_SDA
            int "ANO encoder I2C SDA (STEMMA QT blue)"
            default 0

        config CTLPANEL_PIN_I2C_SCL
            int "ANO encoder I2C SCL (STEMMA QT yellow)"
            default 2

    endmenu

endmenu
```
